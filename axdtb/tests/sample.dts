/dts-v1/;

/ {
	#address-cells = <0x2>;
	#size-cells = <0x2>;
	compatible = "riscv-virtio";

	soc {
		#address-cells = <0x2>;
		#size-cells = <0x2>;
		compatible = "simple-bus";

		virtio_mmio@10001000 {
			reg = <0x0 0x10001000 0x0 0x1000>;
			compatible = "virtio,mmio";
		};
	};
};
